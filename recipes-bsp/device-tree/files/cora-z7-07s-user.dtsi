/ {
    model = "Digilent Cora Z7-07S Development Board";
    compatible = "digilent,zynq-coraz7", "xlnx,zynq-7000";

    reserved-memory {
        #address-cells = <1>;
        #size-cells = <1>;
        ranges;

        photon_bins: photon-bins@1f000000 {
            reg = <0x1f000000 0x10000>;
            no-map;
        };
    };
};